## fw/esp32/rust/sdkconfig.defaults
```kconfig
# Rust ESP-IDF application defaults. Keep this small; the C firmware remains
# the source of truth while components are translated incrementally.

CONFIG_IDF_TARGET="esp32"
CONFIG_ESPTOOLPY_FLASHSIZE_4MB=y
# CONFIG_XTAL_FREQ_26 is not set
# CONFIG_XTAL_FREQ_40 is not set
CONFIG_XTAL_FREQ_AUTO=y
# CONFIG_ESP32_XTAL_FREQ_26 is not set
# CONFIG_ESP32_XTAL_FREQ_40 is not set
CONFIG_ESP32_XTAL_FREQ_AUTO=y
# CONFIG_PARTITION_TABLE_SINGLE_APP is not set
# CONFIG_PARTITION_TABLE_SINGLE_APP_LARGE is not set
CONFIG_PARTITION_TABLE_CUSTOM=y
CONFIG_PARTITION_TABLE_CUSTOM_FILENAME="/ws/rust/ssh-mesh/fw/esp32/rust/partitions_4mb_large_app.csv"
CONFIG_ESP_MAIN_TASK_STACK_SIZE=7168
CONFIG_PTHREAD_TASK_STACK_SIZE_DEFAULT=8192
CONFIG_ESP_SYSTEM_PANIC_PRINT_REBOOT=y
CONFIG_ESP_WIFI_NAN_ENABLE=y
CONFIG_PM_ENABLE=y
CONFIG_FREERTOS_USE_TICKLESS_IDLE=y

# Match the C build's IRAM tradeoff so the full mesh feature set has room on
# classic ESP32 as Rust modules are added.
# CONFIG_ESP_WIFI_IRAM_OPT is not set
# CONFIG_ESP_WIFI_RX_IRAM_OPT is not set
# CONFIG_SPI_MASTER_ISR_IN_IRAM is not set
# CONFIG_SPI_SLAVE_ISR_IN_IRAM is not set
# CONFIG_ESP_SPI_BUS_LOCK_ISR_FUNCS_IN_IRAM is not set

# BLE is needed for companion pairing, command GATT, and raw advertising hints.
# Use NimBLE instead of Bluedroid; the GATT surface is intentionally small and
# NimBLE behaves better on S3 during pairing-advertising bring-up.
CONFIG_BT_ENABLED=y
CONFIG_BT_NIMBLE_ENABLED=y
CONFIG_BT_BLE_ENABLED=y
CONFIG_BTDM_CTRL_MODE_BLE_ONLY=y
# CONFIG_BTDM_CTRL_MODE_BR_EDR_ONLY is not set
# CONFIG_BTDM_CTRL_MODE_BTDM is not set
# CONFIG_BT_BLUEDROID_ENABLED is not set
# CONFIG_BLUEDROID_ENABLED is not set
CONFIG_BT_NIMBLE_ROLE_PERIPHERAL=y
CONFIG_BT_NIMBLE_GATT_SERVER=y
CONFIG_BT_NIMBLE_GAP_SERVICE=y
CONFIG_BT_NIMBLE_SECURITY_ENABLE=y
CONFIG_BT_NIMBLE_MAX_BONDS=3
CONFIG_BT_NIMBLE_MAX_CCCDS=8
CONFIG_BT_NIMBLE_50_FEATURE_SUPPORT=y
```
